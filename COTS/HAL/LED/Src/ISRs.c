/**********************************************************************************************************************
 *  FILE DESCRIPTION
 *  -----------------------------------------------------------------------------------------------------------------*/
/**        \file  FileName.c
 *        \brief  
 *
 *      \details  
 *
 *
 *********************************************************************************************************************/

/**********************************************************************************************************************
 *  INCLUDES
 *********************************************************************************************************************/
#include "../LIBRARIES/common/Std_Types.h"
#include "../HAL/LED/Inc/ISRs.h"
#include "../MCAL/SYSTICK/Inc/Systick.h"
#include "../HAL/LED/Inc/Led.h"

/**********************************************************************************************************************
*  LOCAL MACROS CONSTANT\FUNCTION
*********************************************************************************************************************/

/**********************************************************************************************************************
 *  LOCAL DATA 
 *********************************************************************************************************************/

/**********************************************************************************************************************
 *  GLOBAL DATA
 *********************************************************************************************************************/
uint32_t 					ON_TIME = 0;
uint32_t 					OFF_TIME = 0;
uint32_t 					On_Off = 0;
volatile uint8_t 	On_Off_Ctr = 1;


/**********************************************************************************************************************
 *  LOCAL FUNCTION PROTOTYPES
 *********************************************************************************************************************/

/**********************************************************************************************************************
 *  LOCAL FUNCTIONS
 *********************************************************************************************************************/

/**********************************************************************************************************************
 *  GLOBAL FUNCTIONS
 *********************************************************************************************************************/

void GPIOA_Handler(void)
{
	On_Off++;

	if(On_Off == 3)
	{
			if(ON_TIME > 0 && OFF_TIME > 0)
			{
					On_Off_Ctr = 0;
					On_Off = 0;
			}
	}
	
}
void GPIOC_Handler(void)
{
	
	if(On_Off == 1)
	{
		ON_TIME += 100;

	}
	
}
void GPIOD_Handler(void)
{
	if(On_Off == 2)
	{
		OFF_TIME += 100;
	}
}


/******************************************************************************
* \Syntax          : Std_ReturnType FunctionName(AnyType parameterName)        
* \Description     : Describe this service                                    
*                                                                             
* \Sync\Async      : Synchronous                                               
* \Reentrancy      : Non Reentrant                                             
* \Parameters (in) : parameterName   Parameter Describtion                     
* \Parameters (out): None                                                      
* \Return value:   : Std_ReturnType  E_OK
*                                    E_NOT_OK                                  
*******************************************************************************/


/**********************************************************************************************************************
 *  END OF FILE: FileName.c
 *********************************************************************************************************************/
